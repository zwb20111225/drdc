## kernel/Kconfig
```kconfig
menu "DRDC"

config KSU
	tristate "DRDC function support"
	depends on KPROBES && EXT4_FS
	default y
	help
	  Enable kernel-level root privileges on Android System.
	  Requires CONFIG_KPROBES for kernel hooking support.
	  Requires CONFIG_EXT4_FS for `ext4_unregister_sysfs`.
	  To compile as a module, choose M here: the
	  module will be called drdc.

config KSU_DEBUG
	bool "DRDC debug mode"
	depends on KSU
	default n
	help
	  Enable DRDC debug mode.

# The drdcd watchdog (feature/drdcd_watchdog.c) is intentionally unconditional: an
# external-module build cannot see a freshly added CONFIG_* symbol, so gating it on
# Kconfig silently compiled it away.

config KSU_DISABLE_MANAGER
	bool "Disable DRDC manager integration"
	depends on KSU
	default n
	help
	  Disable manager APK detection and manager-specific handling.
	  Root will be used in place of manager-only functionality.

config KSU_DISABLE_POLICY
	bool "Disable DRDC policy profiles"
	depends on KSU
	default n
	help
	  Disable per-app root/non-root profile customization.
	  Escalation will always use the default full root profile, and
	  non-root handling will follow the global umount policy only.

config KSU_X86_PATCH_SYSCALL_DISPATCHER
	bool "Dynamically patch x64's hardened syscall dispatcher to support syscall hooks"
	depends on KSU && X86_64
	default n
	help
	  Dynamically patch x64's hardened syscall dispatcher to support syscall hooks. This is a
	  replacement for a kernel source code patch, and is useful for x86_64 LKM mode.

endmenu
```
